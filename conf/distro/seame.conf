## conf/layer.conf
```bitbake
# We have a conf and classes directory, add to BBPATH
BBPATH .= ":${LAYERDIR}"

# We have recipes-* directories, add to BBFILES
BBFILES += "${LAYERDIR}/recipes-*/*/*.bb \
            ${LAYERDIR}/recipes-*/*/*.bbappend"

BBFILE_COLLECTIONS += "meta-seame"
BBFILE_PATTERN_meta-seame = "^${LAYERDIR}/"
BBFILE_PRIORITY_meta-seame = "6"

LAYERDEPENDS_meta-seame = "core"
LAYERSERIES_COMPAT_meta-seame = "kirkstone"
```
